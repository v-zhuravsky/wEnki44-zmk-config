## config/boards/shields/jorne_r/Kconfig.shield
```kconfig
# Copyright (c) 2020 The ZMK Contributors
# SPDX-License-Identifier: MIT

config SHIELD_JORNE_R_LEFT
    def_bool $(shields_list_contains,jorne_r_left)

config SHIELD_JORNE_R_RIGHT
    def_bool $(shields_list_contains,jorne_r_right)
```
